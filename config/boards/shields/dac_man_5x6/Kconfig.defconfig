## config/boards/shields/dac_man_5x6/Kconfig.defconfig
```kconfig
if SHIELD_DAC_MAN_5X6_LEFT

config ZMK_KEYBOARD_NAME
    default "Dac-Man-5x6-L"

config ZMK_SPLIT_ROLE_CENTRAL
    default n

endif

if SHIELD_DAC_MAN_5X6_RIGHT

config ZMK_KEYBOARD_NAME
    default "Dac-Man-5x6-R"

config ZMK_SPLIT_ROLE_CENTRAL
    default y

endif
```

## config/drivers/ps2/Kconfig.ps2
```kconfig
# PS/2 GPIO driver configuration

config PS2_GPIO
	bool "PS/2 GPIO driver"
	default y
	depends on GPIO
	select PS2
	help
	  Enable PS/2 GPIO driver for bit-banging PS/2 protocol.

config PS2
	bool

config PS2_INIT_PRIORITY
	int "PS/2 driver init priority"
	default 90
	help
	  PS/2 driver initialization priority.

config PS2_LOG_LEVEL
	int "PS/2 driver log level"
	default 3
	help
	  PS/2 driver log level (0=OFF, 1=ERR, 2=WRN, 3=INF, 4=DBG).
```

## config/west.yml
```yaml
manifest:
  remotes:
    - name: zmkfirmware
      url-base: https://github.com/zmkfirmware
  projects:
    - name: zmk
      remote: zmkfirmware
      revision: v3.5-branch
      import: app/west.yml
    - name: ps2-driver-kim
      url: https://github.com/infused-kim/kb_zmk_ps2_mouse_trackpoint_driver
      path: modules/ps2-kim
      revision: main
  self:
    path: config
```
